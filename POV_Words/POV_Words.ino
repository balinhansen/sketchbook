int clockpin=4;
int latchpin=5;
int datapin=6;

int chars=13;
int col=0;
int count;


byte helloworld[13][7]={
{0x00,0xff,0x08,0x10,0x10,0x0f,0x00},
{0x00,0x3e,0x69,0x49,0x49,0x3a,0x00},
{0x00,0x80,0x80,0xfe,0x01,0x01,0x00},
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{0x00,0x00,0x00,0x00,0x00,0x00,0x00}
};

void setup(){
  
  Serial.begin(115200);
  pinMode(clockpin,OUTPUT);
  pinMode(latchpin,OUTPUT);
  pinMode(datapin,OUTPUT);
  
 digitalWrite(clockpin,LOW);
 digitalWrite(latchpin,LOW);
 digitalWrite(datapin,LOW);
}

void loop(){
 int i;
 byte data=0;
 byte output=0x00;
 output=helloworld[count][col];
 
 digitalWrite(clockpin,HIGH);
 digitalWrite(clockpin,LOW);
 
 digitalWrite(clockpin,HIGH);
 digitalWrite(clockpin,LOW);

 for (i=0;i<8;i++){
   data=output&(1<<i);  
   if (data){
     digitalWrite(datapin,HIGH);
   }else{
     digitalWrite(datapin,LOW);
   }
   digitalWrite(clockpin,LOW);
   digitalWrite(clockpin,HIGH);
   digitalWrite(datapin,LOW);
 }
 
 digitalWrite(clockpin,LOW);
 digitalWrite(latchpin,HIGH);
 digitalWrite(clockpin,HIGH);
 digitalWrite(latchpin,LOW);

 //delay(100);
 col++;
 if (col >=7){
   col=0;
   count++;
 }
 if (count>=chars){
   count=0;
 }
 
 delayMicroseconds(400);
}
