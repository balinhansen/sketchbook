int sensorPin = A0;
int clockpin=4;
int latchpin=5;
int datapin=6;

int chars=10;
int col=0;
int count;
unsigned long finish;

byte nums[10][7]={
  {0x00,0x3c,0xc3,0x91,0xc3,0x3c,0x00}, // 0
  {0x00,0x81,0x81,0xff,0x01,0x01,0x00}, // 1
  {0x00,0x41,0x83,0x85,0x89,0x71,0x00}, // 2
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  {0x00,0x72,0xc9,0x89,0xd2,0x3c,0x00}  // 9
};


    
byte helloworld[13][7]={
{0x00,0xff,0x08,0x10,0x10,0x0f,0x00},
{0x00,0x3e,0x69,0x49,0x49,0x3a,0x00},
{0x00,0x80,0x80,0xfe,0x01,0x01,0x00},
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{0x00,0x00,0x00,0x00,0x00,0x00,0x00}
};

void setup(){
  Serial.begin(115200);
  
  analogReference(INTERNAL);
  
  pinMode(clockpin,OUTPUT);
  pinMode(latchpin,OUTPUT);
  pinMode(datapin,OUTPUT);
    
  digitalWrite(clockpin,LOW);
  digitalWrite(latchpin,LOW);
  digitalWrite(datapin,LOW);
}

void shiftout(){
 
  int i;
  byte data=0;
  byte output=0x00;

  output=nums[count][col];
 
  col++;
  if (col >=7){
    col=0;
    count++;
  }
  if (count>=chars){
    count=0;
  }
 
  digitalWrite(clockpin,HIGH);
  digitalWrite(clockpin,LOW);
 
  digitalWrite(clockpin,HIGH);
  digitalWrite(clockpin,LOW);

  for (i=0;i<8;i++){
    data=output&(1<<i);  
    if (data){
      digitalWrite(datapin,HIGH);
    }else{
      digitalWrite(datapin,LOW);
    }
    digitalWrite(clockpin,LOW);
    digitalWrite(clockpin,HIGH);
    digitalWrite(datapin,LOW);
  }
 
  digitalWrite(clockpin,LOW);
  digitalWrite(latchpin,HIGH);
  digitalWrite(clockpin,HIGH);
  digitalWrite(latchpin,LOW);

}


void loop(){
  double celcius, fahrenheit, temp;
  
  shiftout();
  
  if (micros()>finish){
      
    temp=analogRead(sensorPin);
    celcius=temp/9.31;
    fahrenheit=celcius*1.8+32;
    Serial.print("Temperature: ");
    Serial.print(celcius);
    Serial.print("C / ");
    Serial.print(fahrenheit);
    Serial.println("F");
    
    finish=micros()+1000000;
  }

 
  delayMicroseconds(1600);
 
}
